#include "cyd_ui.h"
#include "app_commands.h"
#include "cyd_display.h"
#include "cyd_touch.h"

#include <string.h>
#include <stdio.h>

#include "esp_desktop_buddy/esp_desktop_buddy.h"
#include "esp_desktop_buddy/transport_ble.h"
#include "esp_log.h"
#include "freertos/FreeRTOS.h"
#include "freertos/task.h"

#define TAG "cyd_ui"
#define UI_TASK_STACK  4096
#define UI_TASK_PRIO   5
#define UI_FRAME_MS    80  /* ~12 fps; 31ms blit + render leaves ~50ms spare */

/* ---- layout constants ---- */
#define Y_HEADER_TOP   0
#define Y_HEADER_H     36
#define Y_STATUS_TOP   36
#define Y_STATUS_H     22
#define Y_PANEL_TOP    58
#define Y_PANEL_H      122
#define Y_ACTION_TOP   182
#define Y_ACTION_H     58
#define X_DIVIDER      159

/* ---- 8×8 bitmap font (printable ASCII 0x20–0x7E, IBM PC 8×8 ROM) ---- */
static const uint8_t s_font[95][8] = {
    {0x00,0x00,0x00,0x00,0x00,0x00,0x00,0x00}, /* 0x20   */
    {0x18,0x3C,0x3C,0x18,0x18,0x00,0x18,0x00}, /* 0x21 ! */
    {0x36,0x36,0x00,0x00,0x00,0x00,0x00,0x00}, /* 0x22 " */
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    {0x6E,0x3B,0x00,0x00,0x00,0x00,0x00,0x00}, /* 0x7E ~ */
};

/* ---- color helpers ---- */
static inline uint16_t rgb16(uint8_t r, uint8_t g, uint8_t b)
{
    uint16_t v = ((uint16_t)(r >> 3) << 11) | ((uint16_t)(g >> 2) << 5) | (b >> 3);
    return (uint16_t)((v >> 8) | (v << 8)); /* big-endian for SPI DMA */
}

/* ---- primitive draw functions (strip-aware: clip y to current strip) ---- */
static void draw_fill(uint16_t *fb, uint16_t color)
{
    for (int i = 0; i < CYD_W * CYD_STRIP_H; i++) {
        fb[i] = color;
    }
}

static void draw_rect(uint16_t *fb, int x, int y, int w, int h, uint16_t color)
{
    for (int row = 0; row < h; row++) {
        int py = y + row;
        int spy = py - g_cyd_strip_y;
        if (spy < 0 || spy >= CYD_STRIP_H) continue;
        for (int col = 0; col < w; col++) {
            int px = CYD_W - 1 - (x + col);
            if (px >= 0 && px < CYD_W) {
                fb[spy * CYD_W + px] = color;
            }
        }
    }
}

static void draw_char(uint16_t *fb, int x, int y, char c, uint16_t color, int scale)
{
    if (c < 0x20 || c > 0x7E) {
        c = '?';
    }
    const uint8_t *glyph = s_font[(uint8_t)c - 0x20];
    for (int row = 0; row < 8; row++) {
        for (int col = 0; col < 8; col++) {
            if (!(glyph[row] & (0x01 << col))) {
                continue;
            }
            for (int sy = 0; sy < scale; sy++) {
                for (int sx = 0; sx < scale; sx++) {
                    int px = CYD_W - 1 - (x + col * scale + sx);
                    int py = y + row * scale + sy;
                    int spy = py - g_cyd_strip_y;
                    if (px >= 0 && px < CYD_W && spy >= 0 && spy < CYD_STRIP_H) {
                        fb[spy * CYD_W + px] = color;
                    }
                }
            }
        }
    }
}

static void draw_text(uint16_t *fb, int x, int y, const char *text, uint16_t color, int scale)
{
    int cx = x;
    for (const char *p = text; *p; p++) {
        draw_char(fb, cx, y, *p, color, scale);
        cx += 8 * scale;
    }
}

/* Word-wrapped text. Returns number of lines drawn. */
static int draw_wrapped(uint16_t *fb, int x, int y, int wrap_w, int max_lines,
                        const char *text, uint16_t color, int scale)
{
    int char_w = 8 * scale;
    int line_h = 8 * scale + 2;
    int cols = wrap_w / char_w;
    int line = 0;
    const char *p = text;

    while (*p && line < max_lines) {
        const char *line_start = p;
        const char *last_space = NULL;
        int n = 0;

        while (*p && n < cols) {
            if (*p == ' ') {
                last_space = p;
            }
            p++;
            n++;
        }

        const char *line_end;
        if (*p == '\0') {
            line_end = p;
        } else if (last_space) {
            line_end = last_space;
            p = last_space + 1;
        } else {
            line_end = p;
        }

        int cx = x;
        for (const char *q = line_start; q < line_end && cx + char_w <= x + wrap_w; q++) {
            draw_char(fb, cx, y + line * line_h, *q, color, scale);
            cx += char_w;
        }
        line++;

        while (*p == ' ') {
            p++;
        }
    }
    return line;
}

/* ---- frame renderer ---- */
static void render_frame(uint16_t *fb, cyd_app_t *app)
{
    example_buddy_state_cache_t state = {0};
    esp_desktop_buddy_transport_ble_state_t transport = {0};
    char display_name[CYD_APP_NAME_MAX];
    char owner_name[CYD_APP_OWNER_MAX];
    char advertising_name[CYD_APP_BLE_NAME_MAX];

    xSemaphoreTake(app->mutex, portMAX_DELAY);
    state = app->state_cache;
    transport = app->transport_state;
    example_safe_copy(display_name, sizeof(display_name), app->display_name);
    example_safe_copy(owner_name, sizeof(owner_name), app->owner_name);
    example_safe_copy(advertising_name, sizeof(advertising_name), app->advertising_name);
    xSemaphoreGive(app->mutex);

    bool prompt_active = state.prompt.present;
    bool passkey_active = transport.has_passkey;

    /* === Background === */
    draw_fill(fb, rgb16(0x0D, 0x0D, 0x0D));

    /* === Header (y=0..35): dark navy, title + BLE status === */
    draw_rect(fb, 0, Y_HEADER_TOP, CYD_W, Y_HEADER_H, rgb16(0x1A, 0x1A, 0x2E));
    draw_text(fb, 8, 4,
              display_name[0] ? display_name : "Desktop Buddy",
              rgb16(0xFF, 0xFF, 0xFF), 2);

    /* BLE status line */
    if (passkey_active) {
        char pk[32];
        snprintf(pk, sizeof(pk), "Pair code: %06lu", (unsigned long)transport.passkey);
        draw_text(fb, 8, 24, pk, rgb16(0xFF, 0xDD, 0x00), 1);
    } else if (!transport.connected) {
        char ble[48];
        snprintf(ble, sizeof(ble), "BLE: Advertising as %.20s",
                 advertising_name[0] ? advertising_name : "...");
        draw_text(fb, 8, 24, ble, rgb16(0x88, 0x88, 0x88), 1);
    } else if (prompt_active) {
        draw_text(fb, 8, 24, "BLE: Connected  |  APPROVAL NEEDED",
                  rgb16(0x00, 0xDD, 0x00), 1);
    } else if (transport.tx_ready) {
        draw_text(fb, 8, 24, "BLE: Connected and ready",
                  rgb16(0x00, 0xDD, 0x00), 1);
    } else {
        draw_text(fb, 8, 24, "BLE: Securing channel...",
                  rgb16(0x66, 0xAA, 0x66), 1);
    }

    /* === Status strip (y=36..57): owner + session counts === */
    {
        char line[48];
        if (owner_name[0]) {
            snprintf(line, sizeof(line), "Owner: %.24s", owner_name);
        } else {
            snprintf(line, sizeof(line), "Owner: (none)");
        }
        draw_text(fb, 8, 38, line, rgb16(0x66, 0x66, 0x88), 1);

        if (state.has_state) {
            snprintf(line, sizeof(line), "Sessions: %lu total  %lu running  %lu waiting",
                     (unsigned long)state.total,
                     (unsigned long)state.running,
                     (unsigned long)state.waiting);
        } else {
            snprintf(line, sizeof(line), "Sessions: no data yet");
        }
        draw_text(fb, 8, 48, line, rgb16(0x66, 0x66, 0x88), 1);
    }

    /* === Prompt panel (y=58..179) === */
    draw_rect(fb, 4, Y_PANEL_TOP, CYD_W - 8, Y_PANEL_H, rgb16(0x1E, 0x2D, 0x40));

    if (passkey_active) {
        draw_text(fb, 8, 62, "Pairing passkey:", rgb16(0xAA, 0xAA, 0xFF), 1);
        char pk[8];
        snprintf(pk, sizeof(pk), "%06lu", (unsigned long)transport.passkey);
        /* Scale-4 passkey: 32px per char, 6 chars = 192px → center x=64 */
        draw_text(fb, 64, 82, pk, rgb16(0xFF, 0xDD, 0x00), 4);
        draw_text(fb, 8, 156, "Enter this code in Claude Desktop",
                  rgb16(0x88, 0x88, 0x88), 1);
    } else if (prompt_active) {
        char title[56];
        snprintf(title, sizeof(title), "%.40s request",
                 state.prompt.tool[0] ? state.prompt.tool : "Approval");
        draw_text(fb, 8, 62, title, rgb16(0x00, 0xAA, 0xFF), 1);

        const char *body = state.prompt.hint[0] ? state.prompt.hint
                         : (state.msg[0]         ? state.msg
                                                  : "Approve this request?");
        /* Scale-2 body: 16px per char, ~19 chars per line, 3 lines max */
        draw_wrapped(fb, 8, 76, 304, 3, body, rgb16(0xFF, 0xFF, 0xFF), 2);

        draw_text(fb, 8, 166, "Tap ALLOW or DENY below",
                  rgb16(0x55, 0x55, 0x55), 1);
    } else {
        draw_text(fb, 8, 62, "Ready", rgb16(0x00, 0xAA, 0xFF), 1);
        const char *body = state.has_state
            ? (state.msg[0] ? state.msg : "Waiting for next prompt")
            : "Connect Claude Desktop via BLE to begin";
        draw_wrapped(fb, 8, 76, 304, 3, body, rgb16(0x88, 0x88, 0x88), 2);
    }

    /* === Action bar (y=182..239) === */
    uint16_t allow_bg = prompt_active ? rgb16(0x00, 0x22, 0x00) : rgb16(0x0A, 0x0A, 0x0A);
    uint16_t allow_fg = prompt_active ? rgb16(0x00, 0xDD, 0x00) : rgb16(0x33, 0x33, 0x33);
    uint16_t deny_bg  = prompt_active ? rgb16(0x22, 0x00, 0x00) : rgb16(0x0A, 0x0A, 0x0A);
    uint16_t deny_fg  = prompt_active ? rgb16(0xFF, 0x33, 0x33) : rgb16(0x33, 0x33, 0x33);

    draw_rect(fb, 0, Y_ACTION_TOP, X_DIVIDER, Y_ACTION_H, allow_bg);
    draw_rect(fb, X_DIVIDER + 1, Y_ACTION_TOP, CYD_W - X_DIVIDER - 1, Y_ACTION_H, deny_bg);

    /* Divider line */
    for (int yd = Y_ACTION_TOP; yd < CYD_H; yd++) {
        int syd = yd - g_cyd_strip_y;
        if (syd >= 0 && syd < CYD_STRIP_H) {
            fb[syd * CYD_W + (CYD_W - 1 - X_DIVIDER)] = rgb16(0x33, 0x33, 0x33);
        }
    }

    /* "ALLOW" centered in left zone (0-158 = 159px wide; text=5*16=80px → x=40) */
    draw_text(fb, 40, 203, "ALLOW", allow_fg, 2);

    /* "DENY" centered in right zone (161-319 = 159px wide; text=4*16=64px → x=209) */
    draw_text(fb, 209, 203, "DENY", deny_fg, 2);
}

/* ---- touch tap processing ---- */
static void process_tap(cyd_app_t *app, int x, int y)
{
    example_buddy_state_cache_t state = {0};
    char prompt_id[EXAMPLE_BUDDY_PROMPT_ID_MAX + 1];

    if (y < Y_ACTION_TOP) {
        return;
    }

    xSemaphoreTake(app->mutex, pdMS_TO_TICKS(100));
    state = app->state_cache;
    xSemaphoreGive(app->mutex);

    if (!state.prompt.present) {
        return;
    }

    snprintf(prompt_id, sizeof(prompt_id), "%s", state.prompt.id);

    if (x < X_DIVIDER) {
        ESP_LOGI(TAG, "allow prompt %s", prompt_id);
        esp_desktop_buddy_prompt_approve_once(app->buddy, prompt_id);
    } else {
        ESP_LOGI(TAG, "deny prompt %s", prompt_id);
        esp_desktop_buddy_prompt_deny(app->buddy, prompt_id);
    }
}

/* ---- UI task ---- */
static void ui_task(void *arg)
{
    cyd_app_t *app = (cyd_app_t *)arg;
    uint16_t *fb = cyd_display_fb();
    bool touch_was_down = false;
    int tap_x = 0, tap_y = 0;

    while (true) {
        TickType_t frame_start = xTaskGetTickCount();

        g_cyd_strip_y = 0;
        render_frame(fb, app);
        cyd_display_flush();

        g_cyd_strip_y = CYD_STRIP_H;
        render_frame(fb, app);
        cyd_display_flush();

        /* Process touch after flush (SPI2 idle, SPI3 free) */
        int tx, ty;
        bool touching = cyd_touch_read(&tx, &ty);
        if (touching && !touch_was_down) {
            touch_was_down = true;
            tap_x = CYD_W - 1 - tx;  /* mirror X to match display flip */
            tap_y = ty;
        } else if (!touching && touch_was_down) {
            touch_was_down = false;
            process_tap(app, tap_x, tap_y);
        }

        /* Maintain target frame rate */
        TickType_t elapsed = xTaskGetTickCount() - frame_start;
        TickType_t target = pdMS_TO_TICKS(UI_FRAME_MS);
        if (elapsed < target) {
            vTaskDelay(target - elapsed);
        }
    }
}

esp_err_t cyd_ui_init(cyd_app_t *app)
{
    BaseType_t rc = xTaskCreatePinnedToCore(ui_task, "cyd_ui", UI_TASK_STACK,
                                            app, UI_TASK_PRIO, NULL, 1);
    return rc == pdPASS ? ESP_OK : ESP_ERR_NO_MEM;
}
